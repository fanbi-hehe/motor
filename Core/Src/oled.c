/**
 * oled.c —— 0.98 寸 I2C OLED 驱动 (128x64, SSD1306 / SH1106 通用)
 * ------------------------------------------------------------------
 * 用"页寻址"直接往屏幕 RAM 里写:
 *   - 屏幕分成 8 页, 每页 8 个像素高、128 列宽
 *   - 每个字符 6 列 x 8 行, 一页正好放一行字
 *   - 每次把一行(21 个字 = 126 列)拼成 126 字节发出去
 *
 * 这样做不需要显存, 也不需要整屏刷新, 单次 I2C 只占几毫秒。
 */
#include "oled.h"
#include "i2c.h"
#include <string.h>

/* 7 位地址左移 1 位。大部分模块是 0x3C, 少数是 0x3D */
#define OLED_ADDR_7BIT   0x3C
#define OLED_ADDR_ALT    0x3D

#define FONT_W           6      /* 每个字符 6 列 */
#define COLS             21     /* 128 / 6 = 21 个字符 */

static uint8_t s_addr8 = (OLED_ADDR_7BIT << 1);   /* 实际用的 8 位地址 */

/* ---------------------------------------------------------------- */
/* 6x8 ASCII 字库: 字符 32(' ') ~ 126('~'), 每个 6 字节                */
/* 每个字节是一列, bit0 在上面, bit7 在下面                          */
/* ---------------------------------------------------------------- */
static const uint8_t font6x8[95][FONT_W] = {
  {0x00,0x00,0x00,0x00,0x00,0x00}, /* ' ' */
  {0x00,0x00,0x5F,0x00,0x00,0x00}, /* '!' */
  {0x00,0x07,0x00,0x07,0x00,0x00}, /* '"' */
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  {0x10,0x08,0x08,0x10,0x08,0x00}, /* '~' */
};

/* ---------------------------------------------------------------- */
/* 底层: 发命令 / 发数据                                             */
/* ---------------------------------------------------------------- */

/* 发 1 个命令字节 (控制字节 0x00 表示"后面是命令") */
static void OLED_Cmd(uint8_t cmd)
{
  uint8_t buf[2];
  buf[0] = 0x00;
  buf[1] = cmd;
  HAL_I2C_Master_Transmit(&hi2c1, s_addr8, buf, 2, 100);
}

/* 指定"从第几页的第 0 列开始写" */
static void OLED_SetPos(uint8_t page)
{
  OLED_Cmd((uint8_t)(0xB0 | (page & 0x07)));   /* 页地址 */
  OLED_Cmd(0x00);                              /* 列地址低 4 位 */
  OLED_Cmd(0x10);                              /* 列地址高 4 位 */
}

/* ---------------------------------------------------------------- */
/* 对外接口                                                          */
/* ---------------------------------------------------------------- */

void OLED_Init(void)
{
  /* 初始化命令表 (SSD1306 和 SH1106 都认这套) */
  static const uint8_t init_cmd[] = {
    0xAE,              /* 关显示 */
    0xD5, 0x80,        /* 时钟分频 */
    0xA8, 0x3F,        /* 复用率 = 64 行 */
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    0xAF,              /* 开显示 */
  };
  uint8_t buf[1 + 128];
  uint8_t page;

  /* 找屏幕: 先试 0x3C, 不响应再试 0x3D */
  if (HAL_I2C_IsDeviceReady(&hi2c1, (OLED_ADDR_7BIT << 1), 2, 50) == HAL_OK)
  {
    s_addr8 = (OLED_ADDR_7BIT << 1);
  }
  else if (HAL_I2C_IsDeviceReady(&hi2c1, (OLED_ADDR_ALT << 1), 2, 50) == HAL_OK)
  {
    s_addr8 = (OLED_ADDR_ALT << 1);
  }
  else
  {
    return;                        /* 没接屏幕就直接不显示, 不影响电机 */
  }

  /* 一次性把初始化命令发完: buf[0]=0x00 表示后面全是命令 */
  buf[0] = 0x00;
  memcpy(&buf[1], init_cmd, sizeof(init_cmd));
  HAL_I2C_Master_Transmit(&hi2c1, s_addr8, buf,
                          (uint16_t)(1u + sizeof(init_cmd)), 100);

  /* 清屏: 8 页全部写 0 */
  memset(&buf[1], 0x00, 128);
  buf[0] = 0x40;                   /* 0x40 = 后面是数据 */
  for (page = 0; page < 8; page++)
  {
    OLED_SetPos(page);
    HAL_I2C_Master_Transmit(&hi2c1, s_addr8, buf, 129, 100);
  }
}

void OLED_ShowLine(uint8_t line, const char *text)
{
  uint8_t buf[1 + COLS * FONT_W];   /* 1 个控制字节 + 126 个点阵字节 */
  uint8_t i;
  uint8_t ended = 0;

  if (line > 7)
  {
    return;
  }

  buf[0] = 0x40;                    /* 后面是显示数据 */

  /* 把字符串拆成点阵, 不足 21 字补空格(顺便擦掉上一次的残留) */
  for (i = 0; i < COLS; i++)
  {
    uint8_t c = ' ';

    if (ended == 0u)
    {
      c = (uint8_t)text[i];
      if (c == '\0')
      {
        ended = 1u;                 /* 遇到结束符之后一律补空格 */
        c = ' ';
      }
    }
    if ((c < 32u) || (c > 126u))
    {
      c = ' ';
    }
    memcpy(&buf[1 + i * FONT_W], font6x8[c - 32], FONT_W);
  }

  OLED_SetPos(line);
  HAL_I2C_Master_Transmit(&hi2c1, s_addr8, buf, (uint16_t)sizeof(buf), 100);
}
